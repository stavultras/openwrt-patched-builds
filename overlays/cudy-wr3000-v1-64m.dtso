// Same changes as patches/Cudy-WR3000-V1-64MB-NOR.patch, applied to the stock DTB
/dts-v1/;
/plugin/;

&{/} {
	model = "Cudy WR3000 v1 64MB NOR";
};

&{/soc/spi@11009000/flash@0/partitions/partition@f0000} {
	reg = <0xf0000 0x3f10000>;
};
